AUTOSAR XML (schema 00046)
package /SR_Interface_Lab
  sender receiver interface SR_Interface
    data write_data: sw-impl-policy=QUEUED, type=uint16
  sensor actuator sw component type Sensor_send_data
    provide port Data_sender: provided-interface=SR_Interface
  application sw component type application_sw
    require port receive_data: required-interface=SR_Interface
