AUTOSAR XML (schema 00046)
package /CS_Interface_Lab
  client server interface CS_INT_SUM
    operation CS_SUM
      arg IN1: type=uint16, direction=IN
      arg IN2: type=uint16, direction=IN
      arg OUT: type=uint16, direction=OUT
  application sw component type CLINT_APPLICATION
    require port aSK_FOR_SERVACE: client-server-annotation=CS_SUM
  application sw component type Receiver_application
    provide port send_service: client-server-annotation=CS_SUM
