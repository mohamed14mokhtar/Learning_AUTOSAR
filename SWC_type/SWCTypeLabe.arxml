AUTOSAR XML (schema 00046)
package /SWCs_AEBs_PACKAGE
  sensor actuator sw component type Lider_SWC1
  sensor actuator sw component type ReedSpeed_SWC2
  application sw component type AEBS_SWC3
  ecu abstraction sw component type IOABS_SWC4
  parameter interface ConstPra_SWC5
  sensor actuator sw component type LedWarning_SWC6
  complex device driver sw component type Break_Action_SWC7
  service sw component type DigMang_SWC8
  nv block sw component type Flash_NVbLK_SWC9
